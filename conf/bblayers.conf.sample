## conf/bblayers.conf.sample
```bitbake
# LAYER_CONF_VERSION is increased each time build/conf/bblayers.conf
# changes incompatibly
LCONF_VERSION = "7"

BBPATH = "${TOPDIR}"
BBFILES ?= ""
MONK_DIR = "${@os.path.abspath(os.path.dirname(d.getVar('FILE', True)) + '/../..')}"

BBLAYERS ?= " \
  ${MONK_DIR}/openembedded-core/meta \
  ${MONK_DIR}/meta-monkos \
  "
```

## conf/distro/include/monkos-distro-features.inc
```bitbake
# We dont want (L)GPL-3.0+
#INCOMPATIBLE_LICENSE = "GPLv3.0 GPLv3 GPL-3.0 GPLv3+ LGPLv3.0 LGPLv3 LGPL-3.0 LGPLv3+"
#WHITELIST_GPLv3 = "make readline gdbm coreutils diffutils bash grep"
#WHITELIST_LGPLv2 = "make"
#WHITELIST_GPLv3+ = "readline"
#WHITELIST_GPL-3.0 = "${WHITELIST_GPLv3}"

PREFERRED_VERSION_linux-yocto ?= "4.14%"

# Override these in poky based distros
MONKOS_DEFAULT_DISTRO_FEATURES = "largefile opengl ptest multiarch wayland vulkan"
MONKOS_DEFAULT_EXTRA_RDEPENDS = "packagegroup-core-boot"
MONKOS_DEFAULT_EXTRA_RRECOMMENDS = "kernel-module-af-packet"


DISTRO_FEATURES_DEFAULT_remove = "x11 irda 3g nfc"

DISTRO_FEATURES = "${DISTRO_FEATURES_DEFAULT} ${DISTRO_FEATURES_LIBC} ${MONKOS_DEFAULT_DISTRO_FEATURES}"
DISTRO_FEATURES_append = " systemd"
VIRTUAL-RUNTIME_init_manager = "systemd"
VIRTUAL-RUNTIME_initscripts = ""
DISTRO_FEATURES_BACKFILL_CONSIDERED = "sysvinit"

DISTRO_EXTRA_RDEPENDS += " ${MONKOS_DEFAULT_EXTRA_RDEPENDS}"
DISTRO_EXTRA_RRECOMMENDS += " ${MONKOS_DEFAULT_EXTRA_RRECOMMENDS}"
```

## conf/distro/monkos.conf
```bitbake
#
# Definition of Monk OS distro
#

# Distro details
DISTRO = "monkos"
DISTRO_NAME = "Monk OS"
DISTRO_VERSION = "0.1"
DISTRO_CODENAME = "electra"

# SDK details
SDK_VENDOR = "-monksdk"
SDK_VERSION := "${@'${DISTRO_VERSION}'.replace('snapshot-${DATE}','snapshot')}"
SDK_NAME = "${DISTRO}-${TCLIBC}-${SDK_ARCH}-${TARGET_ARCH}"
SDK_NAME = "${DISTRO}-${TCLIBC}-${SDK_ARCH}-${IMAGE_BASENAME}-${TUNE_PKGARCH}"
SDKPATH = "/opt/${DISTRO}/${SDK_VERSION}"

MAINTAINER = "Johan Saji <johansaji.dev@gmail.com>"

TARGET_VENDOR = "-monk"

LOCALCONF_VERSION = "1"

DISTRO_VERSION[vardepsexclude] = "DATE"
SDK_VERSION[vardepsexclude] = "DATE"

require conf/distro/include/monkos-distro-features.inc
require conf/distro/include/monkos-distro-settings.inc
require conf/distro/include/monkos-image-settings.inc

TCLIBCAPPEND = ""

# The CONNECTIVITY_CHECK_URI's are used to test whether we can succesfully
# fetch from the network (and warn you if not). To disable the test set
# the variable to be empty.
# Git example url: git://git.yoctoproject.org/yocto-firewall-test;protocol=git;rev=master
CONNECTIVITY_CHECK_URIS ?= "https://www.example.com/"

#
# OELAYOUT_ABI allows us to notify users when the format of TMPDIR changes in
# an incompatible way. Such changes should usually be detailed in the commit
# that breaks the format and have been previously discussed on the mailing list
# with general agreement from the core team.
#
OELAYOUT_ABI = "12"

require conf/distro/include/no-static-libs.inc
```

## conf/layer.conf
```bitbake
# We have a conf and classes directory, add to BBPATH
BBPATH .= ":${LAYERDIR}"

# We have recipes-* directories, add to BBFILES
BBFILES += "${LAYERDIR}/recipes-*/*/*.bb ${LAYERDIR}/recipes-*/*/*.bbappend"

BBFILE_COLLECTIONS += "monkos"
BBFILE_PATTERN_monkos = "^${LAYERDIR}/"
BBFILE_PRIORITY_monkos = "100"

# This should only be incremented on significant changes that will
# cause compatibility issues with other layers
LAYERVERSION_monkos = "1"

LAYERDEPENDS_monkos = "core"

LAYERSERIES_COMPAT_monkos = "sumo"
```
